/*
 * led_wave_demo.c - play the chant into an LED instead of the speaker.
 *
 * WHY THIS EXISTS
 * ---------------
 * The amp breakout and the flash breakout are not built yet, but the part of
 * the firmware that is actually hard - a jitter-free sample clock feeding a PWM
 * compare register in real time - needs neither of them. This demo runs that
 * whole path on a bare dev board and shows the result as brightness. If the LED
 * follows the chant, the timing core is correct, and stage 6 of
 * docs/bring-up.md becomes "connect the amp" rather than "write and debug the
 * player".
 *
 * WHAT IT DOES NOT TOUCH
 * ----------------------
 * PC3 (amp enable) and the four SPI pins are never configured. Audio comes from
 * a const array in MCU flash, generated by tools/wav2led.py. U2 and U3 are not
 * involved at all.
 *
 * THE ONE THING WORTH UNDERSTANDING
 * ---------------------------------
 * You cannot "play" audio on an LED. Audio swings symmetrically about the
 * mid-point (128 in our unsigned-8 format). Push those bytes straight into the
 * PWM duty at 8 kHz and the average duty is ~50 % for every chant, every tone,
 * and every silence-that-is-not-quite-silent. Your eye is a low-pass filter
 * with roughly a 20 ms window, so it sees the average and nothing else: the LED
 * sits at a constant half brightness and tells you nothing.
 *
 * So the demo rectifies and smooths first. Brightness follows the *envelope*
 * (how loud), not the waveform (which way the cone is moving). That is what a
 * VU meter does, and it is what makes a chant visible.
 *
 * Two source formats, chosen by tools/wav2led.py:
 *   MODE_PCM8 - the real 8 kHz sample stream. The ISR rectifies and smooths, as
 *               above. Exercises the true sample clock, but 16 KB of MCU flash
 *               holds only ~1.2 s of it.
 *   MODE_ENV  - envelope precomputed on the host at ~100 Hz. About 100 bytes
 *               per second, so a whole 60 s chant fits in MCU flash. Same ISR,
 *               same PWM, just a slower tick.
 */

#include "ch32fun.h"
#include "demo_board.h"
#include <stdint.h>

/* ------------------------------------------------------------------------- */
/* Audio data                                                                */

#define MODE_PCM8   0
#define MODE_ENV    1

#if defined(__has_include)
#  if __has_include("chant_led.h")
#    include "chant_led.h"
#    define HAVE_CHANT_DATA 1
#  endif
#endif

#ifndef HAVE_CHANT_DATA
/* No chant_led.h yet - run tools/wav2led.py to make one. Until then, a 1 Hz
 * breathing ramp, so the board does something recognisable and you can prove
 * the wiring before you have any audio converted. */
#define CHANT_LED_MODE  MODE_ENV
#define CHANT_LED_RATE  32u
static const uint8_t chant_led_data[] = {
      0,   2,  10,  21,  37,  57,  79, 103, 127, 152, 176, 198, 218, 234, 245, 253,
    255, 253, 245, 234, 218, 198, 176, 152, 128, 103,  79,  57,  37,  21,  10,   2,
};
#define CHANT_LED_LEN   (sizeof(chant_led_data))
#endif

/* ------------------------------------------------------------------------- */
/* State shared with the ISR                                                 */

static volatile uint32_t play_pos;
static volatile uint8_t  running;
static volatile uint16_t env;      /* PCM8 mode only: magnitude << 6, 0..8192 */

/* ------------------------------------------------------------------------- */
/* Output stage                                                              */

/* Write a 0..255 brightness into the PWM compare register. Inlined and
 * branch-light because this runs inside the sample ISR. */
static inline void led_set(uint16_t v)
{
#if LED_GAMMA_SQUARE
    v = (uint16_t)((v * v) >> 8);      /* gamma 2 - see demo_board.h */
#endif
#if LED_ACTIVE_LOW
    v = 255u - v;
#endif
    TIM1->CH1CVR = v;
}

/* TIM1 CH1 on PD2: 48 MHz / 256 = 187.5 kHz carrier, 8-bit duty.
 *
 * Same timer, same channel, same pin and same period as the product's audio
 * PWM. The only thing that differs is what hangs off the pin - an LED here, an
 * RC filter and an amplifier there - which is why this demo is worth trusting.
 *
 * TIM1 is an advanced-control timer, so its outputs stay dead until MOE is set
 * in BDTR. Forgetting that is the classic "PWM looks configured, pin does
 * nothing" on this part. */
static void pwm_init(void)
{
    RCC->APB2PCENR |= PIN_LED_RCC | RCC_APB2Periph_TIM1 | RCC_APB2Periph_AFIO;

    /* Alternate-function push-pull, 10 MHz slew (ample for 187.5 kHz):
     * CNF = 10, MODE = 01 -> nibble 0x9. */
    PIN_LED_PORT->CFGLR &= ~(0xfu << (4 * PIN_LED_NUM));
    PIN_LED_PORT->CFGLR |=  (0x9u << (4 * PIN_LED_NUM));

    TIM1->PSC     = 0;                        /* no prescale: full 48 MHz    */
    TIM1->ATRLR   = AUDIO_PWM_PERIOD - 1;     /* 255 -> 8-bit, 187.5 kHz     */
    TIM1->CHCTLR1 = TIM_OC1M_2 | TIM_OC1M_1 | TIM_OC1PE;   /* PWM mode 1     */
    TIM1->CCER   |= TIM_CC1E;
    TIM1->BDTR   |= TIM_MOE;                  /* advanced timer: arm outputs */
    TIM1->CH1CVR  = 0;
    TIM1->SWEVGR |= TIM_UG;                   /* latch the preloaded values  */
    TIM1->CTLR1  |= TIM_ARPE | TIM_CEN;

    led_set(0);
}

/* ------------------------------------------------------------------------- */
/* Sample clock                                                              */

/*
 * The sample tick is SysTick, not TIM1, and that choice is half the value of
 * this demo.
 *
 * src/audio.c flags the problem: the carrier is 187.5 kHz and
 * 187500 / 8000 = 23.4375, so no whole-number division of the TIM1 update event
 * lands on 8 kHz. Dividing the core clock instead lands exactly:
 * 48 000 000 / 8000 = 6000. SysTick is otherwise unused, is 32-bit with
 * hardware auto-reload, and costs an ISR that does one load and one store. The
 * carrier stays at exactly 187.5 kHz and the sample rate at exactly 8 kHz, so
 * pitch error is the oscillator's, not the divider's.
 *
 * Offered as a candidate answer to the open question in docs/decisions.md -
 * prove it here, then adopt it in src/audio.c.
 */
void SysTick_Handler(void) __attribute__((interrupt));
void SysTick_Handler(void)
{
    SysTick->SR = 0;               /* clear first, or it immediately re-fires */

    if (!running)
        return;

    uint8_t s = chant_led_data[play_pos];

#if CHANT_LED_MODE == MODE_PCM8
    /* Rectify about mid-scale, then attack-instant / release-slow. */
    int16_t  d   = (int16_t)s - 128;
    uint16_t mag = (d < 0) ? (uint16_t)(-d) : (uint16_t)d;   /* 0..128        */
    uint16_t m   = (uint16_t)(mag << 6);                     /* headroom      */

    if (m > env)
        env = m;                                   /* attack: follow at once */
    else
        env -= env >> LED_RELEASE_SHIFT;           /* release: one-pole decay */

    uint32_t v = ((uint32_t)(env >> 6) * 2u * LED_GAIN_Q4) >> 4;
#else
    /* Already an envelope - the host did the rectifying and the smoothing. */
    uint32_t v = ((uint32_t)s * LED_GAIN_Q4) >> 4;
#endif

    if (v > 255u)
        v = 255u;
    led_set((uint16_t)v);

    if (++play_pos >= CHANT_LED_LEN) {
        play_pos = 0;
        running  = 0;
    }
}

static void tick_init(void)
{
    SysTick->CTLR = 0;
    SysTick->CNT  = 0;
    SysTick->CMP  = (FUNCONF_SYSTEM_CORE_CLOCK / CHANT_LED_RATE) - 1;
    SysTick->SR   = 0;
    /* STE | STIE | STCLK (count HCLK, not HCLK/8) | STRE (auto-reload). */
    SysTick->CTLR = 0x0f;
    /* Note the capital K - that is how the WCH header spells this enumerator.
     * If your ch32v003fun checkout spells it SysTick_IRQn, change it here. */
    NVIC_EnableIRQ(SysTick_IRQn);
}

/* ------------------------------------------------------------------------- */
/* Input                                                                     */

static void switch_init(void)
{
    RCC->APB2PCENR |= RCC_APB2Periph_GPIOD;
    /* Input with pull resistor: CNF = 10, MODE = 00 -> nibble 0x8. Writing the
     * output data register high then selects pull-UP rather than pull-down. */
    PIN_SW_PORT->CFGLR &= ~(0xfu << (4 * PIN_SW_NUM));
    PIN_SW_PORT->CFGLR |=  (0x8u << (4 * PIN_SW_NUM));
    PIN_SW_PORT->BSHR   =  (1u << PIN_SW_NUM);
}

static int switch_pressed(void)
{
    return !(PIN_SW_PORT->INDR & (1u << PIN_SW_NUM));   /* active LOW */
}

/* Same shape as the product's debounce: see it low, wait, see it low again. */
static int debounced_press(void)
{
    if (!switch_pressed())
        return 0;
    Delay_Ms(SW_DEBOUNCE_MS);
    return switch_pressed();
}

/* ------------------------------------------------------------------------- */

static void play_once(void)
{
    play_pos = 0;
    env      = 0;
    running  = 1;

    while (running) {
        /* In the product this is where audio_service() refills the spent buffer
         * from SPI flash. Here the data is already in MCU flash so there is
         * nothing to do - but the structure is the same, and how much slack
         * this loop has is exactly the thing the real player depends on. */
        __asm__ volatile ("nop");
    }

    led_set(0);
}

int main(void)
{
    SystemInit();

    pwm_init();
    switch_init();
    tick_init();

    play_once();                      /* prove life at power-on */

    for (;;) {
#if DEMO_PRESS_TO_PLAY
        if (debounced_press()) {
            play_once();
            while (switch_pressed())  /* one press, one play */
                Delay_Ms(10);
            Delay_Ms(SW_DEBOUNCE_MS);
        }
#else
        Delay_Ms(400);
        play_once();
#endif
    }
}
